## drivers/gpu/ion/exynos/Kconfig
```kconfig
config ION_EXYNOS_CONTIGHEAP_SIZE
	int "Size in Kilobytes of memory pool of EXYNOS_CONTIG_HEAP"
	depends on ION_EXYNOS && CMA
	default 6144

config ION_EXYNOS_DRM_MFC_SH
	bool "ION Heap for drm mfc sh"
	depends on EXYNOS_CONTENT_PATH_PROTECTION
	default y

config ION_EXYNOS_DRM_MSGBOX_SH
	bool "ION Heap for drm msgbox sh"
	depends on EXYNOS_CONTENT_PATH_PROTECTION
	default y

config ION_EXYNOS_DRM_MFC_FW
	bool "ION Heap for drm fw"
	depends on EXYNOS_CONTENT_PATH_PROTECTION
	default y

config ION_EXYNOS_DRM_SECTBL
	bool "ION Heap for drm sectbl"
	depends on EXYNOS_CONTENT_PATH_PROTECTION
	default y

config ION_EXYNOS_DRM_VIDEO
	int "Reserved memsize in kilobytes for VIDEO"
	depends on EXYNOS_CONTENT_PATH_PROTECTION
	default 145408

config ION_EXYNOS_DRM_MEMSIZE_FIMD_VIDEO
	int "Reserved memsize in kilobytes for FIMD VIDEO"
	depends on EXYNOS_CONTENT_PATH_PROTECTION
	default 0

config ION_EXYNOS_DRM_MEMSIZE_MFC_OUTPUT
	int "Reserved memsize in kilobytes for MFC OUTPUT"
	depends on EXYNOS_CONTENT_PATH_PROTECTION
	default 0

config ION_EXYNOS_DRM_MEMSIZE_MFC_INPUT
	int "Reserved memsize in kilobytes for MFC INPUT"
	depends on EXYNOS_CONTENT_PATH_PROTECTION
	default 16384

config ION_EXYNOS_DRM_MEMSIZE_G2D_WFD
	int "Reserved memsize in kilobytes for G2D WFD"
	depends on EXYNOS_CONTENT_PATH_PROTECTION
	default 12288

config ION_EXYNOS_MFC_WFD_SIZE
	int "Size in Kilobytes of memory pool of EXYNOS_MFC_WFD"
	depends on EXYNOS_CONTENT_PATH_PROTECTION
	default 5400
```

## drivers/gpu/mali400/Kconfig
```kconfig
menuconfig MALI400
	tristate "Mali-300/400/450 support"
	depends on ARM
	default y
	---help---
	This enables support for the ARM Mali-300, Mali-400, and Mali-450
	GPUs.

	To compile this driver as a module, choose M here: the module will be
	called mali.

choice
depends on MALI400
prompt "Select MALI VER"
default MALI_VER_R3P2
config MALI_VER_R3P2
	bool "Mali400 Version R3P2"
	help
	  Choose this option to select DDK version.

config MALI_VER_R5P2
    bool "Mali400 Version R5P2"
    help
        R5P2

endchoice
if MALI_VER_R3P2
source "drivers/gpu/mali400/r3p2/mali/Kconfig"
endif
if MALI_VER_R5P2
source "drivers/gpu/mali400/r5p2/mali/Kconfig"
endif
```
